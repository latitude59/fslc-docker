## conf/layer.conf
```bitbake
# We have a conf and classes directory, add to BBPATH
BBPATH .= ":${LAYERDIR}"

# We have recipes-* directories, add to BBFILES
BBFILES += "${LAYERDIR}/recipes-*/*/*.bb \
	${LAYERDIR}/recipes-*/*/*.bbappend"

BBFILE_COLLECTIONS += "meta-fslc-docker"
BBFILE_PATTERN_meta-fslc-docker = "^${LAYERDIR}/"
BBFILE_PRIORITY_meta-fslc-docker = "6"
```
